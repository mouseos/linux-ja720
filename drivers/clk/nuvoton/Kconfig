## drivers/clk/nuvoton/Kconfig
```kconfig
# SPDX-License-Identifier: GPL-2.0
# common clock support for Nuvoton SoC family.

config COMMON_CLK_NUVOTON
	bool "Nuvoton clock controller common support"
	depends on ARCH_MA35 || COMPILE_TEST
	default ARCH_MA35
	help
	  Say y here to enable common clock controller for Nuvoton platforms.

if COMMON_CLK_NUVOTON

config CLK_MA35D1
	bool "Nuvoton MA35D1 clock controller support"
	default ARCH_MA35
	help
	  Build the clock controller driver for MA35D1 SoC.

endif

config COMMON_CLK_W55FA93
	bool "Nuvoton W55FA93 clock controller support"
	depends on OF
	help
	  Support for the clock controller in the Nuvoton W55FA93
	  (N32905) SoC: APLL/UPLL rate decode and AHB/APB clock gates.
```
